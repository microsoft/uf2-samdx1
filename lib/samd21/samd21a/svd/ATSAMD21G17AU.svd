# ATSAMD21G17AU register map
Vendor: Atmel Corporation; Series: SAMD21; File version: D
Atmel ATSAMD21G17AU device: Cortex-M0+ Microcontroller with 128KB Flash, 16KB SRAM, 45-pin package (refer to http://www.atmel.com/devices/SAMD21G17AU.aspx for more)
CPU: CM0+ r0p1, little endian, no MPU, no FPU, VTOR, 2 interrupt priority bits
Registers are 8-bit, read-write, reset 0x0 unless marked. A register's access mark holds for its fields unless they carry their own. Offsets are from the block's base; lines under a group give offsets from that group; [hi:lo] are bit positions; {n}, {i} and the like mark numbered series; 'fields as' and 'values as' point back to an identical list; <NAME> marks a mode.

## Memory map
0x40000000 PAC0 size 0x8 — Peripheral Access Controller 0
0x40000400 PM size 0x80 — Power Manager
0x40000800 SYSCTRL size 0x80 — System Control
0x40000C00 GCLK size 0x10 — Generic Clock Generator
0x40001000 WDT size 0x10 — Watchdog Timer
0x40001400 RTC size 0x40 — Real-Time Counter
0x40001800 EIC size 0x40 — External Interrupt Controller
0x41000000 PAC1 size 0x8 — Peripheral Access Controller 1
0x41002000 DSU size 0x2000 — Device Service Unit
0x41004000 NVMCTRL size 0x80 — Non-Volatile Memory Controller
0x41004400 PORT size 0x200 — Port Module
0x41004800 DMAC size 0x80 — Direct Memory Access Controller
0x41005000 USB size 0x1000 — Universal Serial Bus
0x41006000 MTB size 0x1000 — Cortex-M0+ Micro-Trace Buffer
0x41007000 HMATRIX size 0x400 — HSB Matrix
0x42000000 PAC2 size 0x8 — Peripheral Access Controller 2
0x42000400 EVSYS size 0x80 — Event System Interface
0x42000800 SERCOM0 size 0x40 — Serial Communication Interface 0
0x42000C00 SERCOM1 size 0x40 — Serial Communication Interface 1
0x42001000 SERCOM2 size 0x40 — Serial Communication Interface 2
0x42001400 SERCOM3 size 0x40 — Serial Communication Interface 3
0x42001800 SERCOM4 size 0x40 — Serial Communication Interface 4
0x42001C00 SERCOM5 size 0x40 — Serial Communication Interface 5
0x42002000 TCC0 size 0x90 — Timer Counter Control 0
0x42002400 TCC1 size 0x90 — Timer Counter Control 1
0x42002800 TCC2 size 0x90 — Timer Counter Control 2
0x42002C00 TC3 size 0x40 — Basic Timer Counter 3
0x42003000 TC4 size 0x40 — Basic Timer Counter 4
0x42003400 TC5 size 0x40 — Basic Timer Counter 5
0x42003800 TC6 size 0x40 — Basic Timer Counter 6
0x42003C00 TC7 size 0x40 — Basic Timer Counter 7
0x42004000 ADC size 0x80 — Analog Digital Converter
0x42004400 AC size 0x40 — Analog Comparators
0x42004800 DAC size 0x10 — Digital Analog Converter
0x42005000 I2S size 0x40 — Inter-IC Sound Interface
0x60000000 PORT_IOBUS size 0x200 — Port Module (IOBUS)

## Interrupts
0 PM_INTREQ (PM)
1 SYSCTRL_INTREQ (SYSCTRL)
2 WDT_INTREQ (WDT)
3 RTC_INTREQ (RTC)
4 EIC_INTREQ (EIC)
5 NVMCTRL_INTREQ (NVMCTRL)
6 DMAC_INTREQ (DMAC)
7 USB_INTREQ (USB)
8 EVSYS_INTREQ (EVSYS)
9 SERCOM0_INTREQ (SERCOM0)
10 SERCOM1_INTREQ (SERCOM1)
11 SERCOM2_INTREQ (SERCOM2)
12 SERCOM3_INTREQ (SERCOM3)
13 SERCOM4_INTREQ (SERCOM4)
14 SERCOM5_INTREQ (SERCOM5)
15 TCC0_INTREQ (TCC0)
16 TCC1_INTREQ (TCC1)
17 TCC2_INTREQ (TCC2)
18 TC3_INTREQ (TC3)
19 TC4_INTREQ (TC4)
20 TC5_INTREQ (TC5)
21 TC6_INTREQ (TC6)
22 TC7_INTREQ (TC7)
23 ADC_INTREQ (ADC)
24 AC_INTREQ (AC)
25 DAC_INTREQ (DAC)
27 I2S_INTREQ (I2S)

## Licence text in the file
============================================================================ Atmel Microcontroller Software Support ============================================================================ Copyright (c) 2016 Atmel Corporation, a wholly owned subsidiary of Microchip Technology Inc. . Licensed under the Apache License, Version 2.0 (the "License"); you may not use this file except in compliance with the License. You may obtain a copy of the Licence at http://www.apache.org/licenses/LICENSE-2.0 . Unless required by applicable law or agreed to in writing, software distributed under the License is distributed on an "AS IS" BASIS, WITHOUT WARRANTIES OR CONDITIONS OF ANY KIND, either express or implied. See the License for the specific language governing permissions and limitations under the License. ============================================================================
